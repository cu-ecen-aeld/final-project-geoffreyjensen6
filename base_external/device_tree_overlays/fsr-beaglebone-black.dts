/dts-v1/;
/plugin/;

#include </home/geoffreyjensen/Desktop/ECEA5307/final-project-geoffreyjensen6/buildroot/output/build/linux-5.4.70/include/dt-bindings/gpio/gpio.h>

&{/chosen} {
	overlays {
		BB_FSR_NETWORK.kernel = __TIMESTAMP__;
	};
};

&{/} {
	fsr{
		compatible = "geoffreyjensen,fsr";
		spice1-gpio = <&gpio1 12 GPIO_ACTIVE_LOW>;
		spice2-gpio = <&gpio1 13 GPIO_ACTIVE_LOW>;
		spice3-gpio = <&gpio0 26 GPIO_ACTIVE_LOW>;
		calibrate-gpio = <&gpio0 27 GPIO_ACTIVE_LOW>;
		status = "okay";
	};			
};
